## config/west.yml
```yaml
manifest:
  remotes:
    - name: rloutier
      url-base: https://github.com/rloutier
  projects:
    - name: zmk
      remote: rloutier
      revision: aekeynox
      import: app/west.yml
  self:
    path: config
```
